## Kconfig
```kconfig
if HAS_SONICLIB

menuconfig SONICLIB_DEBUG
    bool "SonicLib debug"
    default 0

menuconfig SONICLIB_NUM_I2C_BUSES
	int "No. of I2C buses"
	default 1

menuconfig SONICLIB_NUM_SENSORS
	int "Max number of sensor devices"
	default 2

menuconfig SONICLIB_FW_PREFIX
	string "ASIC firmware title prefix"
    default "ch101_gprstr" if CH101
    default "ch201_gprstr" if CH201
	help
		Firmware to flash onto the sensor ASIC.
		Expects the initial prefix of the firmware title, for example, to use the
		GPRSTR firmware with the CH201 sensor, which has two source files
			* ch201_gprstr.c,
			* ch201_gprstr_fw.c,
		and an init function named "ch201_gprstr_init()" you would enter
		"ch201_gprstr" into this field.

endif # HAS_SONICLIB
```
